#include "bsp/ov5640.h"
#include "gpio.h"
#include "i2c.h"

/* 单个 OV5640 寄存器及其需要写入的值。 */
typedef struct
{
  uint16_t reg;
  uint8_t value;
} OV5640_RegValueTypeDef;

volatile uint8_t ov5640_reg_3008 = 0U;
volatile uint8_t ov5640_reg_3808 = 0U;
volatile uint8_t ov5640_reg_3809 = 0U;
volatile uint8_t ov5640_reg_4300 = 0U;
volatile uint8_t ov5640_reg_501f = 0U;
volatile uint8_t ov5640_jpeg_config_step = 0U;
volatile uint8_t ov5640_reg_3821 = 0U;
volatile uint8_t ov5640_reg_3002 = 0U;
volatile uint8_t ov5640_reg_3006 = 0U;

/*
 * OV5640 的通用初始化表。
 * 相机模块本身提供 24 MHz XCLK；此表将并口输出配置为 RGB565。
 * 分辨率由后面的 VGA/QVGA 表进一步选择。
 */
static const OV5640_RegValueTypeDef ov5640_rgb565_common[] =
{
  {0x3103U,0x11U},{0x3008U,0x82U},{0x3008U,0x42U},{0x3103U,0x03U},
  {0x3017U,0xffU},{0x3018U,0xffU},{0x3034U,0x1aU},{0x3037U,0x13U},
  {0x3108U,0x01U},{0x3630U,0x36U},{0x3631U,0x0eU},{0x3632U,0xe2U},
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  {0x5025U,0x00U}
};

static const OV5640_RegValueTypeDef ov5640_rgb565_vga[] =
{
  {0x3035U,0x41U},{0x3036U,0x72U},{0x3c07U,0x08U},{0x3820U,0x42U},
  {0x3821U,0x00U},{0x3814U,0x31U},{0x3815U,0x31U},{0x3800U,0x00U},
  {0x3801U,0x00U},{0x3802U,0x00U},{0x3803U,0xbeU},{0x3804U,0x0aU},
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  {0x5001U,0xa3U},{0x3503U,0x00U},{0x3008U,0x02U}
};

static const OV5640_RegValueTypeDef ov5640_rgb565_qvga[] =
{
  {0x3035U,0x41U},{0x3036U,0x72U},{0x3c07U,0x08U},{0x3820U,0x42U},
  {0x3821U,0x00U},{0x3814U,0x31U},{0x3815U,0x31U},{0x3800U,0x00U},
  {0x3801U,0x00U},{0x3802U,0x00U},{0x3803U,0xbeU},{0x3804U,0x0aU},
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  {0x5001U,0xa3U},{0x3503U,0x00U},{0x3008U,0x02U}
};

static const OV5640_RegValueTypeDef ov5640_jpeg_qvga_output[] =
{
  /* 0x3821[5] 启用 JPEG；0x3002[4:2] 清零以释放 JPEG/JFIFO/SFIFO 复位；
   * 0x3006[5|3] 置位，打开 JPEG 两路时钟。 */
  {0x4713U,0x03U},
  /* JPEG 压缩输出的 VFIFO 尺寸为 QVGA。 */
  {0x4602U,0x01U},{0x4603U,0x40U},{0x4604U,0x00U},{0x4605U,0xf0U},
  {0x4407U,0x04U},{0x440eU,0x00U},{0x460bU,0x37U},{0x460cU,0x22U},
  {0x4837U,0x22U},{0x3824U,0x02U},{0x5001U,0xa3U},
  /* 写 0x3821[5] 后必须再次释放 JPEG/JFIFO/SFIFO 复位并开启时钟，
   * 最后选择 JPEG/YUV 输出路径。 */
  {0x3821U,0x20U},{0x3002U,0x00U},{0x3006U,0xebU},
  {0x4300U,0x30U},{0x501fU,0x00U}
};

static HAL_StatusTypeDef OV5640_ReadReg(uint16_t reg, uint8_t *value)
{
  return HAL_I2C_Mem_Read(&hi2c1, OV5640_I2C_ADDRESS, reg,
                          I2C_MEMADD_SIZE_16BIT, value, 1U, 100U);
}

static HAL_StatusTypeDef OV5640_WriteReg(uint16_t reg, uint8_t value)
{
  return HAL_I2C_Mem_Write(&hi2c1, OV5640_I2C_ADDRESS, reg,
                           I2C_MEMADD_SIZE_16BIT, &value, 1U, 100U);
}

static HAL_StatusTypeDef OV5640_WriteTable(const OV5640_RegValueTypeDef *table,
                                           uint32_t length)
{
  uint32_t index;
  HAL_StatusTypeDef status;

  for (index = 0U; index < length; index++)
  {
    status = OV5640_WriteReg(table[index].reg, table[index].value);
    if (status != HAL_OK)
    {
      return status;
    }
    if ((table[index].reg == 0x3008U) && (table[index].value == 0x82U))
    {
      HAL_Delay(5U);
    }
  }

  return HAL_OK;
}

HAL_StatusTypeDef OV5640_Probe(volatile uint16_t *sensor_id)
{
  uint8_t id_high = 0U;
  uint8_t id_low = 0U;
  HAL_StatusTypeDef status;

  /* PWDN 拉低表示工作；RESET 产生低电平复位脉冲。 */
  HAL_GPIO_WritePin(CAM_PWDN_GPIO_Port, CAM_PWDN_Pin, GPIO_PIN_RESET);
  HAL_GPIO_WritePin(CAM_RESET_GPIO_Port, CAM_RESET_Pin, GPIO_PIN_RESET);
  HAL_Delay(5U);
  HAL_GPIO_WritePin(CAM_RESET_GPIO_Port, CAM_RESET_Pin, GPIO_PIN_SET);
  HAL_Delay(20U);

  status = OV5640_ReadReg(0x300AU, &id_high);
  if (status != HAL_OK)
  {
    return status;
  }

  status = OV5640_ReadReg(0x300BU, &id_low);
  if (status != HAL_OK)
  {
    return status;
  }

  *sensor_id = ((uint16_t)id_high << 8) | id_low;
  return HAL_OK;
}

HAL_StatusTypeDef OV5640_ConfigRGB565VGA(void)
{
  HAL_StatusTypeDef status;

  status = OV5640_WriteTable(ov5640_rgb565_common,
                              sizeof(ov5640_rgb565_common) / sizeof(ov5640_rgb565_common[0]));
  if (status != HAL_OK)
  {
    return status;
  }

  return OV5640_WriteTable(ov5640_rgb565_vga,
                            sizeof(ov5640_rgb565_vga) / sizeof(ov5640_rgb565_vga[0]));
}

HAL_StatusTypeDef OV5640_ConfigRGB565QVGA(void)
{
  HAL_StatusTypeDef status;

  status = OV5640_WriteTable(ov5640_rgb565_common,
                              sizeof(ov5640_rgb565_common) / sizeof(ov5640_rgb565_common[0]));
  if (status != HAL_OK)
  {
    return status;
  }

  status = OV5640_WriteTable(ov5640_rgb565_qvga,
                              sizeof(ov5640_rgb565_qvga) / sizeof(ov5640_rgb565_qvga[0]));
  if (status != HAL_OK)
  {
    return status;
  }

  /* 配置生效后读取关键寄存器，供 Keil Watch 验证。 */
  HAL_Delay(100U);
  status = OV5640_ReadReg(0x3008U, (uint8_t *)&ov5640_reg_3008);
  if (status != HAL_OK)
  {
    return status;
  }
  status = OV5640_ReadReg(0x3808U, (uint8_t *)&ov5640_reg_3808);
  if (status != HAL_OK)
  {
    return status;
  }
  status = OV5640_ReadReg(0x3809U, (uint8_t *)&ov5640_reg_3809);
  if (status != HAL_OK)
  {
    return status;
  }
  return OV5640_ReadReg(0x4300U, (uint8_t *)&ov5640_reg_4300);
}

HAL_StatusTypeDef OV5640_ConfigJPEGQVGA(void)
{
  HAL_StatusTypeDef status;
  ov5640_jpeg_config_step = 1U;
  status = OV5640_WriteTable(ov5640_rgb565_common, sizeof(ov5640_rgb565_common) / sizeof(ov5640_rgb565_common[0]));
  if (status != HAL_OK) return status;
  ov5640_jpeg_config_step = 2U;
  status = OV5640_WriteTable(ov5640_rgb565_qvga, sizeof(ov5640_rgb565_qvga) / sizeof(ov5640_rgb565_qvga[0]));
  if (status != HAL_OK) return status;
  ov5640_jpeg_config_step = 3U;
  status = OV5640_WriteTable(ov5640_jpeg_qvga_output, sizeof(ov5640_jpeg_qvga_output) / sizeof(ov5640_jpeg_qvga_output[0]));
  if (status != HAL_OK) return status;
  HAL_Delay(100U);
  status = OV5640_ReadReg(0x4300U, (uint8_t *)&ov5640_reg_4300);
  if (status != HAL_OK) return status;
  status = OV5640_ReadReg(0x501fU, (uint8_t *)&ov5640_reg_501f);
  if (status != HAL_OK) return status;
  status = OV5640_ReadReg(0x3821U, (uint8_t *)&ov5640_reg_3821);
  if (status != HAL_OK) return status;
  status = OV5640_ReadReg(0x3002U, (uint8_t *)&ov5640_reg_3002);
  if (status != HAL_OK) return status;
  status = OV5640_ReadReg(0x3006U, (uint8_t *)&ov5640_reg_3006);
  if (status == HAL_OK) ov5640_jpeg_config_step = 4U;
  return status;
}
